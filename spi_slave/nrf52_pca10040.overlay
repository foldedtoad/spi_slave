/*
 * Copyright (c) 2019 Callender-Consulting, LLC
 *
 * SPDX-License-Identifier: Apache-2.0
 */

&spi0 {
	compatible = "nordic,nrf-spis";
	status = "okay";
	mosi-pin = <11>;
	miso-pin = <12>;
	sck-pin  = <14>;
	csn-pin  = <13>;
	def-char = <0xFF>;
};
