/*
 * Copyright (c) 2019 Callender-Consulting, LLC
 *
 * SPDX-License-Identifier: Apache-2.0
 */

&spi0 {
	compatible = "nordic,nrf-spi";
	status = "okay";
	mosi-pin = <11>;
	miso-pin = <12>;
	sck-pin  = <14>;
	cs-gpios = <&gpio0 13 0>;
};
